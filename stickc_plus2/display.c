#include "display.h"

#include <string.h>

#include "driver/gpio.h"
#include "driver/rtc_io.h"
#include "freertos/FreeRTOS.h"
#include "freertos/queue.h"
#include "freertos/semphr.h"
#include "freertos/task.h"
#include "driver/spi_master.h"
#include "esp_heap_caps.h"
#include "esp_lcd_panel_io.h"
#include "esp_lcd_panel_ops.h"
#include "esp_lcd_panel_st7789.h"
#include "esp_log.h"

static const char *TAG = "hn_disp";

#define LCD_HOST           SPI2_HOST
#define LCD_PIXEL_CLOCK_HZ (40 * 1000 * 1000)
#define LCD_CMD_BITS       8
#define LCD_PARAM_BITS     8

#define PIN_LCD_SCLK 13
#define PIN_LCD_MOSI 15
#define PIN_LCD_DC   14
#define PIN_LCD_RST  12
#define PIN_LCD_CS   5
#define PIN_LCD_BL   27

#define LCD_H_RES 135
#define LCD_V_RES 240
#define LCD_GAP_X 52
#define LCD_GAP_Y 40

/*
 * These are what the panel ACTUALLY shows, measured with the `p` test pattern
 * (four bands of 0xF800 / 0x07E0 / 0x001F / 0xFFFF) on real hardware. The
 * channel order does not match a plain RGB565 reading of the values, so do not
 * "correct" them from the numbers alone - re-measure with the test pattern.
 */
#define COLOR_BG     0x0000
#define COLOR_WHITE  0xFFFF
#define COLOR_BLUE   0x07E0
#define COLOR_RED    0xF800

#define BMP_NOT_CONNECTED_W 105
#define BMP_NOT_CONNECTED_H 39
static const uint8_t bmp_not_connected[] = {
  0x00, 0x00, 0x00, 0x00, 0x00, 0x00, 0x00, 0x00, 0x00, 0x00, 0x00, 0x00, 0x00, 0x00,
  0x00, 0x00, 0x00, 0x00, 0x00, 0x00, 0x00, 0x00, 0x00, 0x00, 0x00, 0x00, 0x00, 0x00,
  0x00, 0x00, 0x00, 0x0E, 0x00, 0x00, 0x00, 0x00, 0x00, 0x00, 0x00, 0x00, 0x00, 0x00,
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  0x00, 0x00, 0x00, 0x00, 0x00, 0x00, 0x00, 0x00, 0x00, 0x00, 0x00, 0x00, 0x00, 0x00,
};
#define BMP_CONNECTED_W 105
#define BMP_CONNECTED_H 20
static const uint8_t bmp_connected[] = {
  0x00, 0x00, 0x00, 0x00, 0x00, 0x00, 0x00, 0x00, 0x00, 0x00, 0x00, 0x00, 0x00, 0x00,
  0x00, 0x00, 0x00, 0x00, 0x00, 0x00, 0x00, 0x00, 0x00, 0x00, 0x00, 0x00, 0x00, 0x00,
  0x00, 0x00, 0x00, 0x00, 0x00, 0x00, 0x00, 0x00, 0x00, 0x00, 0x00, 0x00, 0x1C, 0x00,
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  0x00, 0x00, 0x00, 0x00, 0x00, 0x00, 0x00, 0x00, 0x00, 0x00, 0x00, 0x00, 0x00, 0x00,
};
#define BMP_RECORDING_W 98
#define BMP_RECORDING_H 23
static const uint8_t bmp_recording[] = {
  0x00, 0x00, 0x00, 0x00, 0x00, 0x00, 0x00, 0x00, 0x00, 0x00, 0x00, 0x00, 0x00,
  0x00, 0x00, 0x00, 0x00, 0x00, 0x00, 0x00, 0x00, 0x00, 0x00, 0x00, 0x00, 0x00,
  0x00, 0x00, 0x00, 0x00, 0x00, 0x00, 0x00, 0x01, 0xCE, 0x00, 0x00, 0x00, 0x00,
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  0x00, 0x00, 0x00, 0x00, 0x00, 0x00, 0x00, 0x00, 0x00, 0x00, 0x00, 0x00, 0x00,
};

static esp_lcd_panel_handle_t s_panel;
static bool s_ready;
static display_status_t s_status = DISPLAY_STATUS_NOT_CONNECTED;
static bool s_parked;

/*
 * The panel is driven from one task only. display_set_status() is called from
 * button_task, audio_stream_task, uart_task, the NimBLE host task and
 * app_main; a full repaint is ~240 SPI transactions, so letting those callers
 * paint directly both raced on the SPI device (leaving the screen black and
 * the caller stuck) and stalled the audio pipeline mid-recording.
 */
static SemaphoreHandle_t s_lock;              /* guards all panel access */
static QueueHandle_t s_req;                   /* depth 1, overwrite: wanted status */
static TaskHandle_t s_task;
static int s_drawn = -1;                      /* last painted status, -1 = unknown */

#define DISPLAY_LOCK()   xSemaphoreTake(s_lock, portMAX_DELAY)
#define DISPLAY_UNLOCK() xSemaphoreGive(s_lock)

static void display_task(void *arg);

static void bl_set(bool on)
{
    gpio_set_level(PIN_LCD_BL, on ? 1 : 0);
}

static esp_err_t fill_rect(int x, int y, int w, int h, uint16_t color)
{
    if (!s_ready || w <= 0 || h <= 0) {
        return ESP_ERR_INVALID_STATE;
    }
    const size_t line_bytes = (size_t)w * sizeof(uint16_t);
    uint16_t *line = heap_caps_malloc(line_bytes, MALLOC_CAP_DMA);
    if (line == NULL) {
        return ESP_ERR_NO_MEM;
    }
    for (int i = 0; i < w; i++) {
        line[i] = color;
    }
    esp_err_t ret = ESP_OK;
    for (int row = 0; row < h; row++) {
        ret = esp_lcd_panel_draw_bitmap(s_panel, x, y + row, x + w, y + row + 1, line);
        if (ret != ESP_OK) {
            break;
        }
    }
    free(line);
    return ret;
}

static esp_err_t blit_mono_bitmap(int x0, int y0, int bw, int bh,
                                  const uint8_t *bmp, uint16_t fg, uint16_t bg)
{
    if (!s_ready) {
        return ESP_ERR_INVALID_STATE;
    }
    const int row_bytes = (bw + 7) / 8;
    const size_t line_bytes = (size_t)bw * sizeof(uint16_t);
    uint16_t *line = heap_caps_malloc(line_bytes, MALLOC_CAP_DMA);
    if (line == NULL) {
        return ESP_ERR_NO_MEM;
    }
    esp_err_t ret = ESP_OK;
    for (int y = 0; y < bh; y++) {
        const uint8_t *src = bmp + y * row_bytes;
        for (int x = 0; x < bw; x++) {
            const uint8_t bit = src[x / 8] & (0x80u >> (x & 7));
            line[x] = bit ? fg : bg;
        }
        ret = esp_lcd_panel_draw_bitmap(s_panel, x0, y0 + y, x0 + bw, y0 + y + 1, line);
        if (ret != ESP_OK) {
            break;
        }
    }
    free(line);
    return ret;
}

esp_err_t display_init(void)
{
    if (s_ready) {
        return ESP_OK;
    }

    if (s_lock == NULL) {
        s_lock = xSemaphoreCreateMutex();
        if (s_lock == NULL) {
            return ESP_ERR_NO_MEM;
        }
    }

    gpio_config_t bl_cfg = {
        .pin_bit_mask = 1ULL << PIN_LCD_BL,
        .mode = GPIO_MODE_OUTPUT,
        .pull_up_en = GPIO_PULLUP_DISABLE,
        .pull_down_en = GPIO_PULLDOWN_DISABLE,
        .intr_type = GPIO_INTR_DISABLE,
    };
    esp_err_t ret = gpio_config(&bl_cfg);
    if (ret != ESP_OK) {
        return ret;
    }
    bl_set(false);

    spi_bus_config_t buscfg = {
        .sclk_io_num = PIN_LCD_SCLK,
        .mosi_io_num = PIN_LCD_MOSI,
        .miso_io_num = -1,
        .quadwp_io_num = -1,
        .quadhd_io_num = -1,
        .max_transfer_sz = LCD_H_RES * 40 * sizeof(uint16_t),
    };
    ret = spi_bus_initialize(LCD_HOST, &buscfg, SPI_DMA_CH_AUTO);
    if (ret != ESP_OK) {
        ESP_LOGE(TAG, "spi_bus_initialize: %s", esp_err_to_name(ret));
        return ret;
    }

    esp_lcd_panel_io_handle_t io = NULL;
    esp_lcd_panel_io_spi_config_t io_config = {
        .dc_gpio_num = PIN_LCD_DC,
        .cs_gpio_num = PIN_LCD_CS,
        .pclk_hz = LCD_PIXEL_CLOCK_HZ,
        .lcd_cmd_bits = LCD_CMD_BITS,
        .lcd_param_bits = LCD_PARAM_BITS,
        .spi_mode = 0,
        .trans_queue_depth = 10,
    };
    ret = esp_lcd_new_panel_io_spi((esp_lcd_spi_bus_handle_t)LCD_HOST, &io_config, &io);
    if (ret != ESP_OK) {
        ESP_LOGE(TAG, "panel_io_spi: %s", esp_err_to_name(ret));
        return ret;
    }

    esp_lcd_panel_dev_config_t panel_config = {
        .reset_gpio_num = PIN_LCD_RST,
        /* Colour constants above were measured with this setting - changing it
         * invalidates them. */
        .rgb_ele_order = LCD_RGB_ELEMENT_ORDER_BGR,
        .bits_per_pixel = 16,
    };
    ret = esp_lcd_new_panel_st7789(io, &panel_config, &s_panel);
    if (ret != ESP_OK) {
        ESP_LOGE(TAG, "st7789: %s", esp_err_to_name(ret));
        return ret;
    }

    ESP_ERROR_CHECK(esp_lcd_panel_reset(s_panel));
    ESP_ERROR_CHECK(esp_lcd_panel_init(s_panel));
    ESP_ERROR_CHECK(esp_lcd_panel_invert_color(s_panel, true));
    ESP_ERROR_CHECK(esp_lcd_panel_set_gap(s_panel, LCD_GAP_X, LCD_GAP_Y));
    ESP_ERROR_CHECK(esp_lcd_panel_mirror(s_panel, false, false));
    ESP_ERROR_CHECK(esp_lcd_panel_disp_on_off(s_panel, true));

    s_ready = true;

    if (s_task == NULL) {
        s_req = xQueueCreate(1, sizeof(display_status_t));
        if (s_req == NULL) {
            return ESP_ERR_NO_MEM;
        }
        if (xTaskCreate(display_task, "display", 3072, NULL, 3, &s_task) != pdPASS) {
            vQueueDelete(s_req);
            s_req = NULL;
            return ESP_ERR_NO_MEM;
        }
    }

    ESP_LOGI(TAG, "LCD ready %dx%d gap(%d,%d)", LCD_H_RES, LCD_V_RES, LCD_GAP_X, LCD_GAP_Y);
    return ESP_OK;
}

static void draw_status(display_status_t status)
{
    const uint8_t *bmp = bmp_not_connected;
    int bw = BMP_NOT_CONNECTED_W;
    int bh = BMP_NOT_CONNECTED_H;
    uint16_t fg = COLOR_WHITE;

    switch (status) {
    case DISPLAY_STATUS_CONNECTED:
        bmp = bmp_connected;
        bw = BMP_CONNECTED_W;
        bh = BMP_CONNECTED_H;
        fg = COLOR_BLUE;
        break;
    case DISPLAY_STATUS_RECORDING:
        bmp = bmp_recording;
        bw = BMP_RECORDING_W;
        bh = BMP_RECORDING_H;
        fg = COLOR_RED;
        break;
    case DISPLAY_STATUS_NOT_CONNECTED:
    default:
        break;
    }

    (void)fill_rect(0, 0, LCD_H_RES, LCD_V_RES, COLOR_BG);
    const int x = (LCD_H_RES - bw) / 2;
    const int y = (LCD_V_RES - bh) / 2;
    (void)blit_mono_bitmap(x, y, bw, bh, bmp, fg, COLOR_BG);
    bl_set(true);
}

static void display_task(void *arg)
{
    (void)arg;
    display_status_t want;

    while (1) {
        if (xQueueReceive(s_req, &want, portMAX_DELAY) != pdTRUE) {
            continue;
        }
        DISPLAY_LOCK();
        /* Skip while parked for deep sleep, and skip repaints that change nothing. */
        if (!s_parked && (int)want != s_drawn) {
            draw_status(want);
            s_drawn = (int)want;
        }
        DISPLAY_UNLOCK();
    }
}

void display_set_status(display_status_t status)
{
    if (!s_ready && display_init() != ESP_OK) {
        return;
    }
    s_status = status;

    /* Never paint on the caller's task: just hand the wanted state over. */
    if (s_req != NULL) {
        (void)xQueueOverwrite(s_req, &status);
        return;
    }

    DISPLAY_LOCK();
    draw_status(status);
    s_drawn = (int)status;
    DISPLAY_UNLOCK();
}

static void sleep_locked(void)
{
    bl_set(false);
    if (s_ready && s_panel != NULL) {
        (void)esp_lcd_panel_disp_on_off(s_panel, false);
        (void)fill_rect(0, 0, LCD_H_RES, LCD_V_RES, COLOR_BG);
    }
    s_drawn = -1;
}

/* Colour calibration aid: paint four known RGB565 values as horizontal bands,
 * top to bottom. Serial 'p'. The constants above were derived from this. */
void display_test_pattern(void)
{
    static const uint16_t bands[4] = { 0xF800, 0x07E0, 0x001F, 0xFFFF };
    DISPLAY_LOCK();
    if (s_ready) {
        const int h = LCD_V_RES / 4;
        for (int i = 0; i < 4; i++) {
            (void)fill_rect(0, i * h, LCD_H_RES, h, bands[i]);
        }
        bl_set(true);
        s_drawn = -1;
    }
    DISPLAY_UNLOCK();
}

void display_sleep(void)
{
    DISPLAY_LOCK();
    sleep_locked();
    DISPLAY_UNLOCK();
}

static void park_pad_low(int gpio_num)
{
    if (!rtc_gpio_is_valid_gpio((gpio_num_t)gpio_num)) {
        return;
    }
    rtc_gpio_init((gpio_num_t)gpio_num);
    rtc_gpio_set_direction((gpio_num_t)gpio_num, RTC_GPIO_MODE_DISABLED);
    rtc_gpio_pullup_dis((gpio_num_t)gpio_num);
    rtc_gpio_pulldown_en((gpio_num_t)gpio_num);
}

static void unpark_pad(int gpio_num)
{
    if (!rtc_gpio_is_valid_gpio((gpio_num_t)gpio_num)) {
        return;
    }
    /* Drop the RTC pulls before handing the pad back to the GPIO matrix. */
    rtc_gpio_pulldown_dis((gpio_num_t)gpio_num);
    rtc_gpio_pullup_dis((gpio_num_t)gpio_num);
    rtc_gpio_deinit((gpio_num_t)gpio_num);
}

void display_prepare_deep_sleep(void)
{
    /* Waits out any repaint already in flight on the display task. */
    DISPLAY_LOCK();
    sleep_locked();

    /*
     * Both pads go high-impedance in deep sleep. Pull them down so the
     * backlight cannot glow, and - more importantly - so RST (G12 = MTDI)
     * reads LOW at the wake-up reset, which keeps VDD_SDIO at 3.3 V for the
     * module's embedded flash.
     */
    park_pad_low(PIN_LCD_BL);
    park_pad_low(PIN_LCD_RST);
    s_parked = true;
    DISPLAY_UNLOCK();
}

esp_err_t display_resume(void)
{
    if (!s_ready) {
        return display_init();
    }

    DISPLAY_LOCK();
    if (s_parked) {
        /*
         * park_pad_low() moved both pads onto the RTC mux, so the digital
         * writes behind bl_set() stop reaching the pin. Hand them back before
         * touching the panel again, or the backlight can never come on.
         */
        unpark_pad(PIN_LCD_RST);
        unpark_pad(PIN_LCD_BL);
        s_parked = false;
    }

    /* The digital OUT/OE latches survived, so this is enough to drive it. */
    bl_set(false);

    esp_err_t ret = ESP_OK;
    if (s_panel != NULL) {
        ret = esp_lcd_panel_disp_on_off(s_panel, true);
    }
    s_drawn = -1;   /* force a repaint on the next display_set_status() */
    DISPLAY_UNLOCK();
    /* Caller redraws (and turns the backlight back on) via display_set_status(). */
    return ret;
}
