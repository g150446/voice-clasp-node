## CMakeLists.txt
```
# SPDX-License-Identifier: Apache-2.0

cmake_minimum_required(VERSION 3.20.0)

set(PM_STATIC_YML_FILE ${CMAKE_CURRENT_SOURCE_DIR}/pm_static.yml)

find_package(Zephyr REQUIRED HINTS $ENV{ZEPHYR_BASE})
project(nordic_main)

target_sources(app PRIVATE
    src/main.c
    src/debug_session.c
    src/tap_processing.c
    src/tap_detector.c
    src/audio_capture.c
    src/adpcm.c
)

# Preserve detector rounding when moving from software floating point to FPU.
target_compile_options(app PRIVATE -ffp-contract=off)
```

## prj.conf
```kconfig
# Zephyr Kernel Configuration for XIAO nRF52840 Sense - nordic-main (Handy BLE)

CONFIG_MAIN_STACK_SIZE=4096

# Heap (BLE stack + MCUmgr + audio needs memory)
CONFIG_HEAP_MEM_POOL_SIZE=65536
CONFIG_SYSTEM_WORKQUEUE_STACK_SIZE=4096

# Logging and console (USB CDC ACM on XIAO nRF52840)
CONFIG_LOG=y
# Deferred logging (the Zephyr default, and what this app has always actually
# run: the old `CONFIG_LOG_MODE_DEFERRED=n` was a no-op because LOG_MODE is a
# Kconfig choice). Do NOT switch to CONFIG_LOG_MODE_IMMEDIATE=y with the CDC ACM
# console: cdc_acm_poll_out() calls LOG_WRN_ONCE("Ring buffer full, discard
# data") when the TX ring is full, which in immediate mode re-enters the log
# output path from inside itself. The ring IS full at boot -- the USB host has
# not opened the port yet -- so the device hangs before configure_watchdog()
# and stops advertising. 0.0.101 was lost to exactly this.
# Flush the deferred log 10x more often instead, so less is lost before a hang.
CONFIG_LOG_PROCESS_THREAD_SLEEP_MS=100
CONFIG_CONSOLE=y
CONFIG_UART_CONSOLE=y
CONFIG_PRINTK=y
CONFIG_CBPRINTF_FP_SUPPORT=y

# USB CDC ACM console
CONFIG_USB_CDC_ACM=y

# Peripherals
CONFIG_GPIO=y
CONFIG_PINCTRL=y

# Audio (PDM microphone)
CONFIG_AUDIO=y
CONFIG_AUDIO_DMIC=y

# Bluetooth Low Energy
CONFIG_BT=y
CONFIG_BT_PERIPHERAL=y
CONFIG_BT_BROADCASTER=y
CONFIG_BT_MAX_CONN=2
CONFIG_BT_SMP=n
CONFIG_BT_GATT_DYNAMIC_DB=y
CONFIG_BT_DEVICE_NAME="ClaspNode"
CONFIG_BT_DEVICE_NAME_DYNAMIC=y
CONFIG_BT_DEVICE_NAME_MAX=20
CONFIG_BT_GATT_CLIENT=y

# BLE MTU (OTA transfer efficiency + audio throughput)
CONFIG_BT_L2CAP_TX_MTU=244
CONFIG_BT_BUF_ACL_RX_SIZE=251
CONFIG_BT_BUF_ACL_TX_SIZE=251
CONFIG_BT_CTLR_DATA_LENGTH_MAX=251
CONFIG_BT_L2CAP_TX_BUF_COUNT=8
CONFIG_BT_ATT_TX_COUNT=12
CONFIG_BT_CONN_TX_MAX=8

# GAP PPCP (Android may apply these after discovery).
# Zephyr default timeout=42 (420 ms) is too short and drops the link.
CONFIG_BT_PERIPHERAL_PREF_MIN_INT=24
CONFIG_BT_PERIPHERAL_PREF_MAX_INT=40
CONFIG_BT_PERIPHERAL_PREF_LATENCY=0
CONFIG_BT_PERIPHERAL_PREF_TIMEOUT=800

# MCUmgr (SMP server for BLE OTA)
CONFIG_MCUMGR=y
CONFIG_MCUMGR_TRANSPORT_BT=y
CONFIG_MCUMGR_GRP_IMG=y
CONFIG_MCUMGR_GRP_IMG_VERBOSE_ERR=y
CONFIG_MCUBOOT_IMGTOOL_SIGN_VERSION="0.0.117+0"
CONFIG_MCUMGR_GRP_OS=y

# DFU runs at the idle interval since 0.0.100 (fast is recording-only), which
# costs 3-4x on OTA. Let the SMP transport request 7.5-15 ms while a transfer
# is active. The default TIMEOUT here is 42 (420 ms) -- the exact value that
# drops Android -- so it must be overridden to match the 8 s used everywhere.
CONFIG_MCUMGR_TRANSPORT_BT_CONN_PARAM_CONTROL=y
CONFIG_MCUMGR_TRANSPORT_BT_CONN_PARAM_CONTROL_MIN_INT=6
CONFIG_MCUMGR_TRANSPORT_BT_CONN_PARAM_CONTROL_MAX_INT=12
CONFIG_MCUMGR_TRANSPORT_BT_CONN_PARAM_CONTROL_LATENCY=0
CONFIG_MCUMGR_TRANSPORT_BT_CONN_PARAM_CONTROL_TIMEOUT=800

# MCUmgr dependencies
CONFIG_IMG_MANAGER=y
CONFIG_MCUBOOT_IMG_MANAGER=y
CONFIG_FLASH=y
CONFIG_FLASH_MAP=y
CONFIG_STREAM_FLASH=y
CONFIG_NET_BUF=y
CONFIG_ZCBOR=y

# Settings persistence (image confirm state survives reboot)
CONFIG_SETTINGS=y
CONFIG_SETTINGS_FCB=y
CONFIG_FCB=y

# Watchdog timer
CONFIG_WATCHDOG=y

# SYSTEMOFF when left alone (3 min from cold boot, 30 min after losing a
# peer -- see ADV_*_SLEEP_MS in main.c). Single or double tap on IMU INT1 wakes.
CONFIG_POWEROFF=y

# Hardware info (read reset cause)
CONFIG_HWINFO=y

# sys_reboot() for the "reboot into the UF2 bootloader" command (RX 0x60 /
# serial 'b'). Already selected transitively, but MCUboot is only reachable by a
# UF2 write, so this path must not silently disappear on a Kconfig reshuffle.
CONFIG_REBOOT=y

# I2C + IMU（LSM6DS3TR-C）
CONFIG_I2C=y
CONFIG_SENSOR=y
CONFIG_LSM6DSL=y
CONFIG_LSM6DSL_TRIGGER_GLOBAL_THREAD=y

# Battery monitoring
CONFIG_ADC=y
CONFIG_BT_BAS=y
CONFIG_NRFX_POWER=y

# Cortex-M4F: shared FP state for main/audio/Bluetooth thread contexts.
CONFIG_FPU=y
CONFIG_FPU_SHARING=y
```

## src/app_diagnostics.h
```c
#ifndef APP_DIAGNOSTICS_H
#define APP_DIAGNOSTICS_H
#include <stdbool.h>
#include <zephyr/logging/log.h>
#include <zephyr/sys/printk.h>
bool app_debug_enabled(void);
/* Do not evaluate format arguments outside an explicitly enabled session. */
#define APP_TRACE(...) do { if (app_debug_enabled()) printk(__VA_ARGS__); } while (0)
#define APP_INFO(...) do { if (app_debug_enabled()) LOG_INF(__VA_ARGS__); } while (0)
#endif
```

## src/audio_capture.c
```c
/*
 * Audio Capture for Voice Bridge BLE
 * PDM Microphone via Zephyr DMIC API on nRF52840
 *
 * Ported from nrf54l15/src/audio_capture.c:
 *   - DT alias: dmic20 → dmic0
 *   - Fallback node: pdm20 → pdm0
 *   - PDM CLK: P1.12 → P1.00
 *   - PDM DIN: P1.13 → P0.16  (configured in board overlay)
 */

#include <zephyr/kernel.h>
#include <zephyr/device.h>
#include <zephyr/audio/dmic.h>
#include <zephyr/logging/log.h>

#include "audio_capture.h"
#include "app_diagnostics.h"

LOG_MODULE_REGISTER(audio_capture, LOG_LEVEL_INF);

/* ============================================================================
 * Configuration
 * ============================================================================ */

#define SAMPLE_RATE         16000
#define SAMPLE_BITS         16
#define CHANNELS            1
#define BYTES_PER_SAMPLE    sizeof(int16_t)

/* 20ms frame = 320 samples = 640 bytes */
#define FRAME_MS            20
#define FRAME_SAMPLES       (SAMPLE_RATE * FRAME_MS / 1000)
#define FRAME_BYTES         (FRAME_SAMPLES * BYTES_PER_SAMPLE * CHANNELS)

/*
 * DMIC driver slab. Keep well above one BLE backpressure stall so the PDM
 * DMA path can continue while the sender thread drains Notify slots.
 * 12 × 20 ms = 240 ms of hardware buffering.
 */
#define BLOCK_COUNT         12
K_MEM_SLAB_DEFINE_STATIC(pdm_mem_slab, FRAME_BYTES, BLOCK_COUNT, 4);

/* ============================================================================
 * Global Variables
 * ============================================================================ */

static const struct device *dmic_dev;
static bool dmic_configured = false;
static bool dmic_started = false;

/* Current audio buffer from dmic_read */
static void *current_block = NULL;
static bool pdm_hw_running = false;

/* ============================================================================
 * Public API
 * ============================================================================ */

int audio_capture_init(void)
{
    if (dmic_configured) {
        return 0;
    }

#ifdef DT_N_ALIAS_dmic0
    dmic_dev = DEVICE_DT_GET(DT_ALIAS(dmic0));
#else
    dmic_dev = DEVICE_DT_GET(DT_NODELABEL(pdm0));
#endif
    if (!device_is_ready(dmic_dev)) {
        LOG_ERR("DMIC device not ready: %s", dmic_dev->name);
        return -ENODEV;
    }

    struct pcm_stream_cfg stream = {
        .pcm_width = SAMPLE_BITS,
        .pcm_rate  = SAMPLE_RATE,
        .block_size = FRAME_BYTES,
        .mem_slab  = &pdm_mem_slab,
    };

    struct dmic_cfg cfg = {
        .io = {
            .min_pdm_clk_freq = 1000000,
            .max_pdm_clk_freq = 3500000,
            .min_pdm_clk_dc   = 40,
            .max_pdm_clk_dc   = 60,
        },
        .streams = &stream,
        .channel = {
            .req_num_streams = 1,
            .req_num_chan = CHANNELS,
            .req_chan_map_lo = dmic_build_channel_map(0, 0, PDM_CHAN_RIGHT),
        },
    };

    int ret = dmic_configure(dmic_dev, &cfg);
    if (ret < 0) {
        LOG_ERR("DMIC configure failed: %d", ret);
        return ret;
    }

    dmic_configured = true;

    APP_INFO("Audio capture initialized: %d Hz, %d-bit, %d ch, %d ms frames",
            SAMPLE_RATE, SAMPLE_BITS, CHANNELS, FRAME_MS);
    APP_TRACE("Audio init OK: %d Hz, %d samples/frame\n", SAMPLE_RATE, FRAME_SAMPLES);
    return 0;
}

int audio_capture_start(void)
{
    if (!dmic_configured) {
        return -EIO;
    }

    if (dmic_started) {
        return 0;
    }

    int ret = dmic_trigger(dmic_dev, DMIC_TRIGGER_START);
    if (ret < 0) {
        LOG_ERR("DMIC start failed: %d", ret);
        return ret;
    }
    pdm_hw_running = true;

    /*
     * Discard frames until the PDM CIC filter's DC offset settles.
     * Fresh start produces a large negative offset (~-30000) that decays
     * ~7.5% per 20ms frame, converging to the mic's bias (~-8).
     * Discard up to 80 frames (1.6s), stopping early when |DC| < 200.
     */
    for (int i = 0; i < 80; i++) {
        void *blk = NULL;
        uint32_t sz;
        if (dmic_read(dmic_dev, 0, &blk, &sz, 100) < 0 || blk == NULL) {
            break;
        }
        int16_t *s = (int16_t *)blk;
        int32_t dc = 0;
        uint32_t n = sz / sizeof(int16_t);
        for (uint32_t j = 0; j < n; j++) {
            dc += s[j];
        }
        dc /= (int32_t)n;
        k_mem_slab_free(&pdm_mem_slab, blk);
        if (dc > -200 && dc < 200) {
            APP_TRACE("PDM settled after %d frames (DC=%d)\n", i + 1, (int)dc);
            break;
        }
    }

    dmic_started = true;
    APP_INFO("Audio capture started");
    APP_TRACE("Audio started\n");
    return 0;
}

int audio_capture_stop(void)
{
    if (!dmic_started) {
        return 0;
    }

    int ret = dmic_trigger(dmic_dev, DMIC_TRIGGER_STOP);
    if (ret < 0) {
        LOG_ERR("DMIC stop failed: %d", ret);
        return ret;
    }
    pdm_hw_running = false;

    if (current_block) {
        k_mem_slab_free(&pdm_mem_slab, current_block);
        current_block = NULL;
    }

    dmic_started = false;
    APP_INFO("Audio capture stopped");
    return 0;
}

int audio_capture_get_data(int16_t **buffer, size_t *size)
{
    if (!dmic_started) {
        return -EAGAIN;
    }

    if (current_block) {
        k_mem_slab_free(&pdm_mem_slab, current_block);
        current_block = NULL;
    }

    uint32_t read_size;
    int ret = dmic_read(dmic_dev, 0, &current_block, &read_size, 200);
    if (ret < 0) {
        LOG_WRN("DMIC read failed: %d", ret);
        return ret;
    }

    if (buffer) {
        *buffer = (int16_t *)current_block;
    }
    if (size) {
        *size = read_size;
    }

    return 0;
}

size_t audio_capture_get_frame_size(void)
{
    return FRAME_BYTES;
}

uint32_t audio_capture_get_sample_rate(void)
{
    return SAMPLE_RATE;
}
```

## src/debug_session.c
```c
#include "debug_session.h"
uint8_t debug_session_request(struct debug_session *s, uint8_t op, uintptr_t owner, int64_t now)
{
    if (op > 2 || !owner) return DEBUG_INVALID;
    if (!op) return DEBUG_OK;
    if (s->owner && s->owner != owner) return DEBUG_BUSY;
    if (op == 1) { s->owner = owner; s->deadline_ms = now + DEBUG_SESSION_MS; }
    else debug_session_clear(s);
    return DEBUG_OK;
}
bool debug_session_expire(struct debug_session *s, int64_t now, bool owner_connected)
{
    if (s->owner && (!owner_connected || now >= s->deadline_ms)) {
        debug_session_clear(s); return true;
    }
    return false;
}
uint16_t debug_session_remaining(const struct debug_session *s, int64_t now)
{
    return !s->owner || now >= s->deadline_ms ? 0 : (uint16_t)((s->deadline_ms - now + 999) / 1000);
}
```

## src/debug_session.h
```c
#ifndef DEBUG_SESSION_H
#define DEBUG_SESSION_H
#include <stdbool.h>
#include <stdint.h>

#define DEBUG_SESSION_MS 600000
/* Wire operations: 0=query, 1=enable/renew, 2=disable. */
enum debug_status { DEBUG_OK, DEBUG_REQUIRED, DEBUG_INVALID, DEBUG_BUSY, DEBUG_QUEUE_FULL };
struct debug_session { uintptr_t owner; int64_t deadline_ms; };
static inline bool debug_session_enabled(const struct debug_session *s) { return s->owner != 0; }
static inline bool debug_session_allowed(const struct debug_session *s, uintptr_t owner) {
    return owner != 0 && s->owner == owner;
}
static inline void debug_session_clear(struct debug_session *s) { s->owner = 0; s->deadline_ms = 0; }
uint8_t debug_session_request(struct debug_session *s, uint8_t op, uintptr_t owner, int64_t now);
bool debug_session_expire(struct debug_session *s, int64_t now, bool owner_connected);
uint16_t debug_session_remaining(const struct debug_session *s, int64_t now);
#endif
```

## src/tap_detector.c
```c
#include "tap_detector.h"

#include <math.h>
#include <string.h>

#define SAMPLES(ms) (((ms) * TAP_SAMPLE_HZ + 999) / 1000)
#define WARMUP SAMPLES(500)
const struct tap_config tap_default_config = TAP_CONFIG_DEFAULT;

bool tap_config_valid(const struct tap_config *c)
{
    return isfinite(c->quiet_g) && c->quiet_g >= 0.05f && c->quiet_g <= 1.0f &&
        isfinite(c->peak_g) && c->peak_g > c->quiet_g && c->peak_g <= 4.0f &&
        isfinite(c->edge_g) && c->edge_g >= 0.05f && c->edge_g <= 4.0f &&
        isfinite(c->dominance) && c->dominance >= 0.0f && c->dominance <= 4.0f &&
        isfinite(c->gravity_alpha) && c->gravity_alpha >= 0.001f && c->gravity_alpha <= 0.1f &&
        isfinite(c->noise_multiplier) && c->noise_multiplier >= 1.0f && c->noise_multiplier <= 10.0f &&
        c->pre_quiet_ms >= 5 && c->pre_quiet_ms <= 200 &&
        c->max_rise_ms >= 5 && c->max_rise_ms <= 100 &&
        c->post_quiet_ms >= 5 && c->post_quiet_ms <= 200 &&
        c->max_pulse_ms >= 5 && c->max_pulse_ms <= 300 &&
        c->min_gap_ms >= 30 && c->min_gap_ms < c->max_gap_ms &&
        c->max_gap_ms <= 700 && c->cooldown_ms >= 100 && c->cooldown_ms <= 3000 &&
        c->suppress_ms >= c->cooldown_ms && c->suppress_ms <= 5000;
}

void tap_detector_reset(struct tap_detector *d)
{
    memset(d, 0, sizeof(*d));
}

enum tap_result tap_detector_push_config(struct tap_detector *d, float x, float y, float z,
                                         const struct tap_config *c)
{
    const float a[3] = {x, y, z};
    float linear[3];
    enum tap_result result = TAP_NONE;
    d->sample++;
    if (!d->initialized) {
        memcpy(d->gravity, a, sizeof(a));
        d->initialized = true;
    }
    for (unsigned i = 0; i < 3; i++) {
        linear[i] = a[i] - d->gravity[i];
        d->gravity[i] += c->gravity_alpha * linear[i];
    }
    /* Orientation-independent impact: the magnitude of the gravity-free
     * acceleration, not any single board axis. The previous axis-dominance
     * gate rejected real taps whose impulse was lateral (posture-dependent
     * double-tap misses), so it is gone; tap-vs-motion separation now rests on
     * the rise rate, edge, peak gate, and pulse-width cap. */
    float magnitude = sqrtf(linear[0] * linear[0] + linear[1] * linear[1] +
                            linear[2] * linear[2]);
    float edge = fabsf(magnitude - d->previous_magnitude);
    d->previous_magnitude = magnitude;
    float threshold = fmaxf(c->peak_g, c->noise_multiplier * d->noise);
    /* Slow background estimate; a short strike must not raise its own gate. */
    if (!d->pulse) {
        d->noise += 0.005f * (fminf(magnitude, 1.0f) - d->noise);
    }
    if (d->quiet >= SAMPLES(c->pre_quiet_ms)) {
        d->last_quiet_sample = d->sample - 1;
    }
    d->quiet = magnitude < c->quiet_g ? d->quiet + (d->quiet < WARMUP) : 0;
    if (d->warmup < WARMUP) {
        d->warmup++;
        return TAP_NONE;
    }

    if (!d->pulse && d->sample >= d->blocked_until &&
        d->last_quiet_sample != 0 &&
        d->sample - d->last_quiet_sample <= SAMPLES(c->max_rise_ms) &&
        magnitude >= threshold && edge >= c->edge_g &&
        (d->last_strike == 0 || d->sample - d->last_strike >= SAMPLES(c->min_gap_ms))) {
        d->pulse = true;
        d->pulse_rejected = false;
        /* A real impulse rises through the quiet threshold BEFORE reaching
         * the peak gate. Retain the preceding quiet window briefly, and count
         * the rise in pulse width rather than demanding a one-sample jump. */
        d->pulse_start = d->last_quiet_sample + 1;
        d->pulse_quiet = 0;
        d->peak_magnitude = magnitude;
    }
    if (d->pulse) {
        d->peak_magnitude = fmaxf(d->peak_magnitude, magnitude);
        d->pulse_quiet = magnitude < c->quiet_g ? d->pulse_quiet + 1 : 0;
        if (d->sample - d->pulse_start - d->pulse_quiet > SAMPLES(c->max_pulse_ms)) {
            d->pulse_rejected = true;
        }
        if (d->pulse_quiet >= SAMPLES(c->post_quiet_ms)) {
            /* The pulse closes once the magnitude returns below the quiet
             * gate; only the width cap can invalidate an impact. */
            bool valid = !d->pulse_rejected;
            d->pulse = false;
            if (valid) {
                uint64_t strike = d->pulse_start;
                d->last_strike = strike;
                if (d->pending && strike - d->first_strike >= SAMPLES(c->min_gap_ms) &&
                    strike - d->first_strike <= SAMPLES(c->max_gap_ms)) {
                    d->pending = false;
                    d->blocked_until = d->sample + SAMPLES(c->cooldown_ms);
                    d->single_suppress_until = d->sample + SAMPLES(c->suppress_ms);
                    result = TAP_DOUBLE;
                } else if (!d->pending) {
                    d->pending = true;
                    d->first_strike = strike;
                }
            }
        }
    }
    /* Allow a second strike at the edge of SAMPLES(c->max_gap_ms) to finish before single.
     * Waiting uses sample time, unaffected by FIFO batch / main-loop jitter. */
    if (d->pending && d->sample - d->first_strike > SAMPLES(c->max_gap_ms) &&
        (!d->pulse || d->pulse_rejected ||
         d->pulse_start - d->first_strike > SAMPLES(c->max_gap_ms))) {
        d->pending = false;
        if (d->sample >= d->single_suppress_until) {
            d->blocked_until = d->sample + SAMPLES(c->cooldown_ms);
            result = TAP_SINGLE;
        }
    }
    return result;
}

enum tap_result tap_detector_push(struct tap_detector *d, float x, float y, float z)
{
    return tap_detector_push_config(d, x, y, z, &tap_default_config);
}
```

## src/tap_detector.h
```c
#ifndef HARNESS_TAP_DETECTOR_H
#define HARNESS_TAP_DETECTOR_H

#include <stdbool.h>
#include <stdint.h>

/* Fixed 416 Hz input, acceleration in g, orientation-independent.
 * A tap is a short, sharp impulse of acceleration MAGNITUDE regardless of
 * which board axis it lands on, so the classifier works at any wrist angle.
 * Known limit: at +/-4 g a maximal wrist jerk and a hard tap both ride the
 * ceiling (measured 3.997 g vs 3.996 g) and are not separable. Widening to
 * +/-8 g was rejected because the shared accelerometer feeds the gesture path,
 * whose sub-0.05 g thresholds fall below an 8 g LSB. Deliberate taps peak
 * 4.97-7.57 g and normal/brisk motion stays <=0.73 g, so everyday accuracy is
 * unaffected; only an all-out jerk can false-trigger. */
#define TAP_SAMPLE_HZ 416
enum tap_result { TAP_NONE, TAP_SINGLE, TAP_DOUBLE };

/* `dominance` is retained for wire/format compatibility but no longer used:
 * an axis-dominance gate rejected real taps whose impulse was lateral, which
 * was the root cause of posture-dependent double-tap misses. */
struct tap_config {
    float quiet_g, peak_g, edge_g, dominance, gravity_alpha, noise_multiplier;
    uint16_t pre_quiet_ms, max_rise_ms, post_quiet_ms, max_pulse_ms;
    uint16_t min_gap_ms, max_gap_ms, cooldown_ms, suppress_ms;
};
#define TAP_CONFIG_DEFAULT {0.50f, 1.0f, 0.30f, 0.0f, 0.015f, 4.0f, \
                           15, 15, 20, 40, 80, 350, 700, 1500}
extern const struct tap_config tap_default_config;
bool tap_config_valid(const struct tap_config *c);

struct tap_detector {
    uint64_t sample, pulse_start, first_strike, last_strike, blocked_until;
    uint64_t single_suppress_until;
    uint64_t last_quiet_sample;
    float gravity[3], noise, previous_magnitude, peak_magnitude;
    unsigned warmup, quiet, pulse_quiet;
    bool initialized, pulse, pulse_rejected, pending;
};

/* Reset on FIFO loss: never classify two strikes across missing data. */
void tap_detector_reset(struct tap_detector *d);
enum tap_result tap_detector_push(struct tap_detector *d, float x, float y, float z);
enum tap_result tap_detector_push_config(struct tap_detector *d, float x, float y,
                                         float z, const struct tap_config *c);

#endif
```

## src/tap_processing.c
```c
#include "tap_processing.h"
#include <math.h>
#include <stddef.h>
enum tap_result tap_process_sample(struct tap_detector *d, const struct tap_config *cfg,
                                   const int16_t raw[3], struct tap_metrics *metrics,
                                   uint16_t *flags)
{
    float accel[3] = {raw[0] * TAP_RAW_TO_G, raw[1] * TAP_RAW_TO_G, raw[2] * TAP_RAW_TO_G};
    bool was_pulse = false, was_rejected = false;
    uint64_t previous_strike = 0;
    if (metrics || flags) {
        previous_strike = d->last_strike;
        if (metrics) {
            was_pulse = d->pulse;
            was_rejected = d->pulse_rejected;
            if (d->initialized) {
                float magnitude = 0.0f;
                for (unsigned axis = 0; axis < 3; axis++) {
                    float linear = accel[axis] - d->gravity[axis];
                    metrics->peak[axis] = fmaxf(metrics->peak[axis], fabsf(linear));
                    magnitude += linear * linear;
                }
                magnitude = sqrtf(magnitude);
                metrics->edge = fmaxf(metrics->edge, fabsf(magnitude - d->previous_magnitude));
            }
            metrics->samples++;
        }
    }
    enum tap_result result = tap_detector_push_config(d, accel[0], accel[1], accel[2], cfg);
    if (metrics) {
        if (!was_pulse && d->pulse) metrics->candidates++;
        if (!was_rejected && d->pulse_rejected) metrics->broad++;
        if (d->last_strike != previous_strike) metrics->strikes++;
        if (was_pulse && !d->pulse && !d->pulse_rejected &&
            d->last_strike == previous_strike) metrics->lateral++;
    }
    if (flags) {
        *flags = (d->pulse ? 1 : 0) | (d->pulse_rejected ? 2 : 0) |
            (d->pending ? 4 : 0) | (d->last_strike != previous_strike ? 8 : 0) |
            (result == TAP_SINGLE ? 16 : 0) | (result == TAP_DOUBLE ? 32 : 0);
        for (unsigned axis = 0; axis < 3; axis++) {
            if (raw[axis] >= 32760 || raw[axis] <= -32760) *flags |= 128;
        }
    }
    return result;
}
```

## src/tap_processing.h
```c
#ifndef TAP_PROCESSING_H
#define TAP_PROCESSING_H
#include "tap_detector.h"
#define TAP_RAW_TO_G 0.000122f  /* +/-4 g full scale -> 0.122 mg/LSB (shared with gesture path) */
struct tap_metrics {
    uint32_t samples, discontinuities, candidates, strikes, broad, lateral;
    float peak[3], edge;
};
/* NULL metrics/flags remove diagnostic work without changing detector state. */
enum tap_result tap_process_sample(struct tap_detector *d, const struct tap_config *cfg,
                                   const int16_t raw[3], struct tap_metrics *metrics,
                                   uint16_t *flags);
#endif
```
