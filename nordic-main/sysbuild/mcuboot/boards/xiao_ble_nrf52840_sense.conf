## sdkconfig.defaults
```kconfig
# Shared defaults; target-specific files:
#   sdkconfig.defaults.esp32            -> common ESP32 NimBLE/UART
#   sdkconfig.defaults.stickc_plus2     -> Plus2 flash/PSRAM/name
#   sdkconfig.defaults.stickc_plus_se   -> Plus SE flash/name
#   sdkconfig.defaults.esp32s3          -> Atom Echo S3R
# Select board with -DHN_BOARD=stickc_plus2|stickc_plus_se|atom_echo_s3r

CONFIG_BT_ENABLED=y
CONFIG_BT_NIMBLE_ENABLED=y
```

## sdkconfig.defaults.esp32s3
```kconfig
# Atom Echo S3R (ESP32-S3) — use HN_BOARD=atom_echo_s3r
CONFIG_IDF_TARGET="esp32s3"
CONFIG_ESPTOOLPY_FLASHSIZE_8MB=y
CONFIG_ESPTOOLPY_FLASHSIZE="8MB"
CONFIG_PARTITION_TABLE_SINGLE_APP_LARGE=y

CONFIG_BT_NIMBLE_ENABLED=y
CONFIG_BT_NIMBLE_ROLE_BROADCASTER=y
CONFIG_BT_NIMBLE_ROLE_CENTRAL=y
CONFIG_BT_NIMBLE_ROLE_OBSERVER=y
CONFIG_BT_NIMBLE_ROLE_PERIPHERAL=y
CONFIG_BT_NIMBLE_HOST_TASK_STACK_SIZE=4096
CONFIG_BT_NIMBLE_MAX_CONNECTIONS=2
CONFIG_BT_NIMBLE_MSYS_1_BLOCK_COUNT=12
CONFIG_BT_NIMBLE_ATT_PREFERRED_MTU=512
CONFIG_BT_NIMBLE_SVC_GAP_DEVICE_NAME="HarnessNode-Echo"
CONFIG_BT_NIMBLE_PINNED_TO_CORE=0
CONFIG_BT_ENABLED=y
CONFIG_BT_BLE_50_SUPPORTED=y
CONFIG_BT_CTRL_BLE_50=y

CONFIG_LOG_DEFAULT_LEVEL_INFO=y
CONFIG_LOG_DEFAULT_LEVEL=3
CONFIG_LOG_MAXIMUM_LEVEL_DEBUG=y
CONFIG_LOG_MAXIMUM_LEVEL=4
CONFIG_BOOTLOADER_LOG_LEVEL_WARN=y
CONFIG_BOOTLOADER_LOG_LEVEL=2

CONFIG_ESP_CONSOLE_USB_SERIAL_JTAG=y
```

## sdkconfig.defaults.stickc_plus2
```kconfig
# M5StickC Plus2 (ESP32-PICO-V3-02)
CONFIG_ESPTOOLPY_FLASHSIZE_8MB=y
CONFIG_ESPTOOLPY_FLASHSIZE="8MB"
CONFIG_PARTITION_TABLE_CUSTOM=y
CONFIG_PARTITION_TABLE_CUSTOM_FILENAME="stickc_plus2/partitions_ota.csv"
CONFIG_PARTITION_TABLE_FILENAME="stickc_plus2/partitions_ota.csv"
CONFIG_ESP32_SPIRAM_SUPPORT=y
CONFIG_SPIRAM=y
CONFIG_SPIRAM_BOOT_INIT=y
CONFIG_SPIRAM_USE_MALLOC=y
CONFIG_BT_NIMBLE_SVC_GAP_DEVICE_NAME="HarnessNode-Plus2"
```

## sdkconfig.defaults.stickc_plus_se
```kconfig
# M5StickC Plus SE (ESP32-PICO-D4, 4 MB, no PSRAM)
CONFIG_ESPTOOLPY_FLASHSIZE_4MB=y
CONFIG_ESPTOOLPY_FLASHSIZE="4MB"
CONFIG_PARTITION_TABLE_CUSTOM=y
CONFIG_PARTITION_TABLE_CUSTOM_FILENAME="stickc_plus_se/partitions_ota.csv"
CONFIG_PARTITION_TABLE_FILENAME="stickc_plus_se/partitions_ota.csv"
# CONFIG_ESP32_SPIRAM_SUPPORT is not set
# CONFIG_SPIRAM is not set
CONFIG_BT_NIMBLE_SVC_GAP_DEVICE_NAME="HarnessNode-PlusSE"
```
